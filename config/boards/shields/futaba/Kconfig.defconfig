## config/boards/shields/futaba/Kconfig.defconfig
```kconfig
if SHIELD_FUTABA

config ZMK_KEYBOARD_NAME
    default "Futaba"

# 分割キーボードの設定を無効化
config ZMK_SPLIT
    default n

endif
```

## config/boards/shields/ihciak/Kconfig.defconfig
```kconfig
# Copyright (c) 2025 The ZMK Contributors
# SPDX-License-Identifier: MIT

if SHIELD_IHCIAK

config ZMK_KEYBOARD_NAME
    default "IHCIAK"

config PMW3360
    default y

config ZMK_MOUSE
    default y

endif
```

## config/boards/shields/ihciak/Kconfig.shield
```kconfig
# Copyright (c) 2025 The ZMK Contributors
# SPDX-License-Identifier: MIT

config SHIELD_IHCIAK
    def_bool $(shields_list_contains,ihciak)
```
